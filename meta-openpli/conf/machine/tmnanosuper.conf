## meta-openpli/conf/machine/tmnanosuper.conf
```bitbake
#@TYPE: Machine
#@NAME: Technomate Twin
#@DESCRIPTION: Machine configuration for the Technomate Twin

IMAGEDIR ?= "update/tmnanooe/cfe"

require conf/machine/include/tmxxe2.inc

MACHINE_FEATURES += "textlcd fan ci"

CHIPSET = "bcm7335"

MACHINE_KERNEL_PR = "r1"
```
